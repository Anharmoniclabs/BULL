## microvm/guest/public/bull_defconfig
```kconfig
# Expanded only by build_public.py; all source versions come from the pinned tree.
BR2_x86_64=y
BR2_TOOLCHAIN_BUILDROOT_GLIBC=y
BR2_TOOLCHAIN_BUILDROOT_CXX=y
BR2_REPRODUCIBLE=y
BR2_DOWNLOAD_FORCE_CHECK_HASHES=y
BR2_DL_DIR="@OUTPUT@/downloads"
BR2_GLOBAL_PATCH_DIR="@INPUTS@/patches"
BR2_INIT_NONE=y
BR2_TARGET_GENERIC_HOSTNAME="bull-guest"
BR2_TARGET_ENABLE_ROOT_LOGIN=n
BR2_ROOTFS_OVERLAY="@INPUTS@/overlay"
BR2_LINUX_KERNEL=y
BR2_LINUX_KERNEL_CUSTOM_VERSION=y
BR2_LINUX_KERNEL_CUSTOM_VERSION_VALUE="7.1.13"
BR2_PACKAGE_HOST_LINUX_HEADERS_CUSTOM_7_1=y
BR2_LINUX_KERNEL_USE_CUSTOM_CONFIG=y
BR2_LINUX_KERNEL_CUSTOM_CONFIG_FILE="@INPUTS@/linux.config"
BR2_LINUX_KERNEL_BZIMAGE=y
BR2_LINUX_KERNEL_NEEDS_HOST_LIBELF=y
BR2_LINUX_KERNEL_NEEDS_HOST_OPENSSL=y
BR2_TARGET_ROOTFS_EXT2=y
BR2_TARGET_ROOTFS_EXT2_4=y
BR2_TARGET_ROOTFS_EXT2_SIZE="1536M"
BR2_TARGET_ROOTFS_EXT2_LABEL="BULL"
# BR2_TARGET_ROOTFS_TAR is not set
BR2_PACKAGE_OPENSSH=y
# BR2_PACKAGE_OPENSSH_CLIENT is not set
# BR2_PACKAGE_OPENSSH_SERVER is not set
BR2_PACKAGE_OPENSSH_KEY_UTILS=y
```
